## backports/Kconfig
```kconfig
config BACKPORT_INTEGRATE
bool
def_bool y

config BACKPORT_DIR
string
default "backports/"

config VERSION
string
default "v6.1.97-1"

config KERNEL_VERSION
string
default "v6.1.97"

config KERNEL_NAME
string
default "Linux"

menuconfig BACKPORT_LINUX
bool "Backport Linux v6.1.97 (backports v6.1.97-1)"
default n
---help---
  Enabling this will let give you the opportunity to use features and
  drivers backported from Linux v6.1.97 on the kernel you are using.
  This is experimental and you should say no unless you'd like to help
  test things.

if BACKPORT_LINUX

source "backports/Kconfig.versions"
source "backports/Kconfig.kernel"
source "backports/Kconfig.sources"
source "backports/Kconfig.local"

endif # BACKPORT_LINUX
```

## backports/Kconfig.sources
```kconfig
# this has the configuration for the backport code
source "backports/compat/Kconfig"

# Backported wireless stack (replaces in-tree cfg80211/mac80211)
source "backports/net/wireless/Kconfig"
source "backports/net/mac80211/Kconfig"

# Backported wireless drivers (replaces in-tree drivers/net/wireless/)
source "backports/drivers/net/wireless/Kconfig"

# The following subsystems already exist in the kernel tree and are NOT
# sourced from backports to avoid Kconfig symbol conflicts:
#   net/qrtr/, drivers/bus/mhi/, drivers/soc/qcom/,
#   drivers/ssb/, drivers/bcma/, drivers/staging/,
#   drivers/net/usb/, drivers/usb/class/
```

## net/wireless/Kconfig.wext
```kconfig
# SPDX-License-Identifier: GPL-2.0-only
#
# Wireless Extensions symbols – kept separate so the in-tree
# net/wireless/Kconfig (which defines CFG80211) is NOT sourced when
# the backported cfg80211 is used.  These are kernel infrastructure
# symbols needed by various in-tree drivers (e.g. Qualcomm CLD).
#

config WIRELESS_EXT
	bool

config WEXT_CORE
	def_bool y

config WEXT_PROC
	def_bool y
	depends on PROC_FS
	depends on WEXT_CORE

config WEXT_SPY
	bool

config WEXT_PRIV
	bool
```
