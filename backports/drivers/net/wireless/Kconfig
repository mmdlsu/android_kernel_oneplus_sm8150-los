## backports/drivers/net/wireless/Kconfig
```kconfig
# SPDX-License-Identifier: GPL-2.0-only
#
# Backported wireless drivers kept in this tree.
# Only MediaTek/Realtek are enabled here.
#

menuconfig WLAN
	bool "Wireless LAN"
	depends on !S390
	depends on NET
	depends on WIRELESS
	default y

if WLAN

source "backports/drivers/net/wireless/mediatek/Kconfig"
source "backports/drivers/net/wireless/ralink/Kconfig"
source "backports/drivers/net/wireless/realtek/Kconfig"

endif # WLAN
```
